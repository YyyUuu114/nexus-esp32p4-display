## sdkconfig.defaults
```kconfig
# Target and flash
CONFIG_IDF_TARGET="esp32p4"
CONFIG_ESPTOOLPY_FLASHMODE_QIO=y
CONFIG_ESPTOOLPY_FLASHSIZE_16MB=y
CONFIG_PARTITION_TABLE_CUSTOM=y
CONFIG_PARTITION_TABLE_CUSTOM_FILENAME="partitions.csv"
CONFIG_PARTITION_TABLE_OFFSET=0x8000

# ESP32-P4 PSRAM and performance
CONFIG_SPIRAM=y
CONFIG_SPIRAM_MODE_HEX=y
CONFIG_SPIRAM_SPEED_200M=y
CONFIG_IDF_EXPERIMENTAL_FEATURES=y
CONFIG_COMPILER_OPTIMIZATION_PERF=y
CONFIG_FREERTOS_HZ=1000
CONFIG_ESP_MAIN_TASK_STACK_SIZE=8192

# ESP32-P4-Function-EV-Board: 7-inch EK79007 MIPI-DSI panel
CONFIG_BSP_LCD_TYPE_1024_600=y
# CONFIG_BSP_LCD_TYPE_1280_800 is not set
# CONFIG_BSP_LCD_TYPE_HDMI is not set
CONFIG_BSP_LCD_COLOR_FORMAT_RGB565=y
# CONFIG_BSP_LCD_COLOR_FORMAT_RGB888 is not set
CONFIG_BSP_LCD_DPI_BUFFER_NUMS=1
# CONFIG_BSP_ERROR_CHECK is not set

# LVGL 9 configuration
CONFIG_LV_CONF_SKIP=y
CONFIG_LV_USE_CLIB_MALLOC=y
CONFIG_LV_USE_CLIB_SPRINTF=y
CONFIG_LV_USE_CLIB_STRING=y
CONFIG_LV_FONT_MONTSERRAT_14=y
CONFIG_LV_FONT_MONTSERRAT_16=y
CONFIG_LV_FONT_MONTSERRAT_18=y
CONFIG_LV_FONT_MONTSERRAT_20=y
CONFIG_LV_FONT_MONTSERRAT_24=y
CONFIG_LV_FONT_MONTSERRAT_28=y
CONFIG_LV_FONT_MONTSERRAT_32=y
CONFIG_LV_FONT_MONTSERRAT_36=y
CONFIG_LV_FONT_MONTSERRAT_40=y
CONFIG_LV_FONT_MONTSERRAT_48=y
CONFIG_LV_USE_ARC=y
CONFIG_LV_USE_CHART=y
CONFIG_LV_USE_LABEL=y
CONFIG_LV_USE_OBSERVER=y

# UART0 remains available for diagnostic logs; NEXUS JSON uses the board's USB Serial/JTAG device.
CONFIG_ESP_CONSOLE_UART_BAUDRATE=115200
CONFIG_ESP_CONSOLE_SECONDARY_NONE=y
```
